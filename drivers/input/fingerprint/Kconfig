## drivers/input/fingerprint/Kconfig
```kconfig
#
#Fingerprint
#
menu "Fingerprint support"
	depends on INPUT

config MTK_FINGERPRINT_SUPPORT
	bool "Mediatek Fingerprint"
	default n
	help
	  Fingerprint mtk driver enable/disable
	  in the kernel.Say Y here if you want to
	  use mediatek fingerprint driver,fingerprint
	  driver will support fingerprint function

config MTK_FINGERPRINT_SELECT
	string "sensor type"
	default "GF318M"
	
#+Bug584789 liaomingzhe.wt, ADD, 20200928, fingerprint bringup
config CDFINGER_RO
    bool "cdfinger Fingerprint"
    default n
    ---help---
    cdfinger fingerprint chip.

config CHIPONE_FINGERPRINT
	bool "chipone Fingerprint"
	default n
	help
	  chipone fingerprint 7332 device.
#-Bug584789 liaomingzhe.wt, ADD, 20200928, fingerprint bringup

#+Bug, xiaoguang.wt, add, 20200928, add fingerprint driver bringup
config CDFINGER_FP
    bool "cdfinger Fingerprint"
    default n
    ---help---
    cdfinger fingerprint chip.

config SILEAD_FP
    bool "silead Fingerprint"
    default n
    ---help---
    silead fingerprint chip.    
#-Bug, xiaoguang.wt, add, 20200928, add fingerprint driver bringup

endmenu
```

## drivers/input/touchscreen/mediatek/Ilitek_9882h/Kconfig
```kconfig
#
# ILITEK Touchscreen driver configuration
#
		
config TOUCHSCREEN_MTK_ILITEK_9882H_TS
    bool "ILITEK Touchscreen"
    depends on spi
    default n
    help
      Say Y here if you have ILITEK touch panel.
      If unsure, say N.
      
```

## drivers/input/touchscreen/mediatek/Kconfig
```kconfig
#
# Touchscreen driver configuration
#
menuconfig INPUT_TOUCHSCREEN
	bool "Touchscreens"
	help
	  Say Y here, and a list of supported touchscreens will be displayed.
	  This option doesn't affect the kernel.

	  If unsure, say Y.

if INPUT_TOUCHSCREEN

config TOUCHSCREEN_MTK
	bool "MediaTek Touch Panel Driver"
	help
	  Say Y here if you have MediaTek touch panel.

	  If unsure, say N.

	  To compile this dirver as a module, choose M here: the
	  module will be called.

config TOUCHSCREEN_PHYSICAL_ROTATION_WITH_LCM
	bool "MediaTek Touch Panel Rotation With LCM"
	default y
	help
	  Say N here if touch panel is not physical rotated as LCM does.
	  Physically rotated means that this driver will map
	  the reported coordination to diagonal position.

	  If unsure, say Y.

config TOUCHSCREEN_MTK_FOCALTECH_TS
	bool "FOCALTECH_TS for Mediatek package"
	default n
	help
	  Say Y here if you have focaltech_touch touch panel.

	  If unsure, say N.

	  To compile this dirver as a module, choose M here: the
	  module will be called.

source "drivers/input/touchscreen/mediatek/focaltech_touch/Kconfig"

config TOUCHSCREEN_MTK_FOCALTECH_TS_FT8006P
	bool "FOCALTECH_TS_FT8006P for Mediatek package"
	default n
	help
	  Say Y here if you have focaltech_touch touch panel.

	  If unsure, say N.

	  To compile this dirver as a module, choose M here: the
	  module will be called.

source "drivers/input/touchscreen/mediatek/focaltech_touch_ft8006p/Kconfig"

config TOUCHSCREEN_MTK_FOCALTECH_TS_FT8006P_BOE
	bool "FOCALTECH_TS_FT8006P for Mediatek package"
	default n
	help
	  Say Y here if you have focaltech_touch touch panel.

	  If unsure, say N.

	  To compile this dirver as a module, choose M here: the
	  module will be called.

source "drivers/input/touchscreen/mediatek/focaltech_touch_ft8006p_boe/Kconfig"

config TOUCHSCREEN_HIMAX_CHIPSET
	bool "Himax touchpanel CHIPSET"
	depends on I2C
	help
	  Say Y here if you have a Himax CHIPSET touchscreen.
	  HIMAX controllers are multi touch controllers which can
	  report 10 touches at a time.

          If unsure, say N.
source "drivers/input/touchscreen/mediatek/hxchipset/Kconfig"

config TOUCHSCREEN_MTK_ILITEK_TS
	bool "ILITEK_TS for Mediatek package"
	default n
	help
	  Say Y here if you have ilitek_touch touch panel.

          If unsure, say N.
	  To compile this dirver as a module, choose M here: the
	  module will be called.

source "drivers/input/touchscreen/mediatek/Ilitek_touch/Kconfig"

config TOUCHSCREEN_HIMAX_CHIPSET_651R
	bool "Himax touchpanel CHIPSET"
	depends on I2C
	help
	  Say Y here if you have a Himax CHIPSET touchscreen.
	  HIMAX controllers are multi touch controllers which can
	  report 10 touches at a time.

          If unsure, say N.
source "drivers/input/touchscreen/mediatek/hxchipset_651r/Kconfig"

config TOUCHSCREEN_MTK_ILITEK_9882H_TS
	bool "ILITEK_TS for Mediatek package"
	default n
	help
	  Say Y here if you have ilitek_touch touch panel.

          If unsure, say N.
	  To compile this dirver as a module, choose M here: the
	  module will be called.

source "drivers/input/touchscreen/mediatek/Ilitek_9882h/Kconfig"

config TOUCHSCREEN_MTK_ILITEK_V3_9882H_TS
	bool "ILITEK_V3_TS for Mediatek package"
	default n
	help
	  Say Y here if you have ilitek_touch touch panel.

          If unsure, say N.
	  To compile this dirver as a module, choose M here: the
	  module will be called.

source "drivers/input/touchscreen/mediatek/ILITEK_V3/Kconfig"

config TOUCHSCREEN_CHIPONE
	tristate "Chipone TDDI touchscreen for Mediatek package"
	depends on SPI
	default y
	help
	  Say y here if you have chipone TDDI touch panel.

	  If unsure, say N.

	  To compile this driver as a module, choose M here: the
	  module will be called chipone-tddi.


endif
```

## drivers/switch/Kconfig
```kconfig
menuconfig SWITCH
	tristate "Switch class support"
	help
	  Say Y here to enable switch class support. This allows
	  monitoring switches by userspace via sysfs and uevent.

#if SWITCH

config SWITCH
	tristate "Switch class support"
	default y
	help
	  Say Y here to enable switch_class switch support.

config SWITCH_GPIO
	tristate "GPIO Swith support"
	depends on GPIOLIB
	help
	  Say Y here to enable GPIO based switch support.


#endif # SWITCH
```
